## CMakeLists.txt
```
# SPDX-License-Identifier: Apache-2.0

cmake_minimum_required(VERSION 3.20.0)

find_package(Zephyr REQUIRED HINTS $ENV{ZEPHYR_BASE})

project(led_and_button)

zephyr_include_directories(include/)

target_sources(app PRIVATE src/main.c src/button.c)
```

## west.yml
```
manifest:
  remotes:
    - name: zephyrproject-rtos
      url-base: https://github.com/zephyrproject-rtos
  projects:
    - name: zephyr
      remote: zephyrproject-rtos
      clone-depth: 1
      revision: v4.1.0
path: led_and_button
```

## prj.conf
```kconfig
CONFIG_GPIO=y

CONFIG_ZBUS=y
```

## src/main.c
```c
/*
 * Copyright (c) 2012-2014 Wind River Systems, Inc.
 *
 * SPDX-License-Identifier: Apache-2.0
 */

#include <stdio.h>
#include "button.h"

int main(void)
{
	printf("Button is running on %s board\n", CONFIG_BOARD_TARGET);

	button_init();

	return 0;
}
```

## include/button.h
```c
/**
 * @file button.h
 * @brief Interface for the button events.
 * 
 * This file declares the button event types, the structure of the 
 * event message, the zbus channel for the events and the button.c functions.
 *
 */

#ifndef _BUTTON_H_
#define _BUTTON_H_
#include <zephyr/zbus/zbus.h>

enum button_evt_type {
	BUTTON_EVT_UNDEFINED, /** Button event undefined */
	BUTTON_EVT_PRESSED, /** Button press event */
	BUTTON_EVT_RELEASED, /** Button release event */
	BUTTON_EVT_LONGPRESS, /** Button longpress event */
};

/** Struct of the message with the button event information */
struct msg_button_evt {
	enum button_evt_type evt;
};

/** Deckaration of the button event channel in zbus */
ZBUS_CHAN_DECLARE(chan_button_evt);

/**
 * @brief Initialization of the button
 * 
 * Checks if the device is ready, if it is then it configures its pin as an input.
 * 
 * @return Returns 0 if successful or an error code if it fails.
 */
int button_init(void);
/**
 * @brief Enabling of the interrupts for the button.
 * 
 * Configures the interrupts for both rising and falling edges and 
 * registers the callback handler.
 *
 * @return Return 0 if successful or an error code if it fails.
 */
int button_enable_interrupts(void);

#endif /* _BUTTON_H_ */
```

## src/button.c
```c
#include "button.h"

#include <zephyr/kernel.h>
#include <zephyr/device.h>
#include <zephyr/drivers/gpio.h>
#include <zephyr/sys/util.h>
#include <zephyr/sys/printk.h>
#include <inttypes.h>

ZBUS_CHAN_DEFINE(chan_button_evt, struct msg_button_evt, NULL, NULL, ZBUS_OBSERVERS_EMPTY,
		 ZBUS_MSG_INIT(.evt = BUTTON_EVT_UNDEFINED));

#define SLEEP_TIME_MS 1

/*
 * Get button configuration from the devicetree sw0 alias. This is mandatory.
 */
#define SW0_NODE DT_ALIAS(sw0)
#if !DT_NODE_HAS_STATUS_OKAY(SW0_NODE)
#error "Unsupported board: sw0 devicetree alias is not defined"
#endif
static const struct gpio_dt_spec button = GPIO_DT_SPEC_GET(SW0_NODE, gpios);
static struct gpio_callback button_cb_data;

void button_pressed(const struct device *dev, struct gpio_callback *cb, uint32_t pins)
{
	struct msg_button_evt msg = {.evt = BUTTON_EVT_UNDEFINED};

	if (gpio_pin_get_dt(&button)) {
		msg.evt = BUTTON_EVT_PRESSED;
		printk("Button pressed at %" PRIu32 "\n", k_cycle_get_32());
		int32_t press_time = k_uptime_get();
	} else {
		msg.evt = BUTTON_EVT_RELEASED;
		printk("Button released at %" PRIu32 "\n", k_cycle_get_32());
		int32_t released_time = k_uptime_get();
	}

	zbus_chan_pub(&chan_button_evt, &msg, K_NO_WAIT);

	if(released_time - press_time >= 3000) {
		msg.evt = BUTTON_EVENT_LONG_PRESS;
	}

	zbus_chan_pub(&chan_button_evt, &msg, K_NO_WAIT);
}

int button_init(void)
{
	int ret;

	if (!gpio_is_ready_dt(&button)) {
		printk("Error: button device %s is not ready\n", button.port->name);
		return -ENODEV;
	}

	ret = gpio_pin_configure_dt(&button, GPIO_INPUT);
	if (ret != 0) {
		printk("Error %d: failed to configure %s pin %d\n", ret, button.port->name,
		       button.pin);
		return ret;
	}

	return 0;
}

int button_enable_interrupts(void)
{
	int ret = gpio_pin_interrupt_configure_dt(&button, GPIO_INT_EDGE_BOTH);
	if (ret != 0) {
		printk("Error %d: failed to configure interrupt on %s pin %d\n", ret,
		       button.port->name, button.pin);
		return ret;
	}

	gpio_init_callback(&button_cb_data, button_pressed, BIT(button.pin));
	gpio_add_callback(button.port, &button_cb_data);

	return 0;
}
```
